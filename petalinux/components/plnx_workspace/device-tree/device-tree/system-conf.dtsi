/*
 * CAUTION: This file is automatically generated by PetaLinux SDK.
 * DO NOT modify this file
 */


/ {
	chosen {
		bootargs = "earlycon console=ttyPS1,115200 clk_ignore_unused root=/dev/ram0 rw cma=900M";
		stdout-path = "serial1:115200n8";
	};
};

&gem3 {
	local-mac-address = [00 0a 35 00 45 04];
};

